#include "SPI.h"
#include "TFT_22_ILI9225.h"
#include "math.h"
#include <Wire.h>
#include <VL53L0X.h>
#include <PololuLedStrip.h>

VL53L0X sensor;
PololuLedStrip<3> ledStrip;
#define LED_COUNT 60
rgb_color colors[LED_COUNT];
rgb_color color;

#if defined (ARDUINO_ARCH_STM32F1)
#define TFT_RST PA1
#define TFT_RS  PA2
#define TFT_CS  PA0 // SS
#define TFT_SDI PA7 // MOSI
#define TFT_CLK PA5 // SCK
#define TFT_LED 0 // 0 if wired to +5V directly
#elif defined(ESP8266)
#define TFT_RST 4   // D2
#define TFT_RS  5   // D1
#define TFT_CLK 14  // D5 SCK
//#define TFT_SDO 12  // D6 MISO
#define TFT_SDI 13  // D7 MOSI
#define TFT_CS  15  // D8 SS
#define TFT_LED 2   // D4     set 0 if wired to +5V directly -> D3=0 is not possible !!
#elif defined(ESP32)
#define TFT_RST 26  // IO 26
#define TFT_RS  25  // IO 25
#define TFT_CLK 14  // HSPI-SCK
//#define TFT_SDO 12  // HSPI-MISO
#define TFT_SDI 13  // HSPI-MOSI
#define TFT_CS  15  // HSPI-SS0
#define TFT_LED 0 // 0 if wired to +5V directly
#else
#define TFT_RST 8
#define TFT_RS  9
#define TFT_CS  10  // SS
#define TFT_SDI 11  // MOSI
#define TFT_CLK 13  // SCK
#define TFT_LED 3   // 0 if wired to +5V directly
#endif

#define TFT_BRIGHTNESS 200 // Initial brightness of TFT backlight (optional)

// Use hardware SPI (faster - on Uno: 13-SCK, 12-MISO, 11-MOSI)
TFT_22_ILI9225 tft = TFT_22_ILI9225(TFT_RST, TFT_RS, TFT_CS, TFT_LED, TFT_BRIGHTNESS);


int button_pin = 7;
int piezo_pin = 6;

// 'pre-ccap logo_small', 220x51px
const unsigned char myBitmap [] PROGMEM = {
  0xff, 0xff, 0xff, 0xff, 0xff, 0xff, 0xff, 0xff, 0xff, 0xff, 0xff, 0xff, 0xff, 0xff, 0xff, 0xff, 
  0xff, 0xff, 0xff, 0xff, 0xff, 0xff, 0xff, 0xff, 0xff, 0xff, 0xff, 0xf0, 0xff, 0xff, 0xff, 0xff, 
  0xff, 0xff, 0xff, 0xff, 0xff, 0xff, 0xff, 0xff, 0xff, 0xff, 0xff, 0xff, 0xff, 0xff, 0xff, 0xff, 
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  0xff, 0xff, 0xff, 0xf0
};



// Setup
void setup() {
  pinMode(button_pin, INPUT);
  pinMode(piezo_pin, OUTPUT);
  
  Serial.begin(9600);
  Wire.begin();

  sensor.init();
  sensor.setTimeout(500);
  sensor.startContinuous();
  
  tft.begin();
  
  tft.clear();
}

// Loop
void loop() {
  int hz;
  int pump = 0;
  int prev_pump = 0;
  int tx = 13;
  int ty = 46;
  int tx2 = 13;
  int ty2 = 126;
  int x;
  int temp;
  int pres;
  int on = false;
  tft.setOrientation(3);
  tft.setBackgroundColor(COLOR_WHITE);
  tft.fillRectangle(0, 0, tft.maxX(), tft.maxY(), COLOR_WHITE); //220 x 176
  tft.drawBitmap(0, tft.maxY()/2 - 51/2, myBitmap, 224, 51, COLOR_WHITE, COLOR_ORANGE);
  RGB_color(255,0,0);
  tone(piezo_pin, 50);
  delay(200);
  tone(piezo_pin, 250);
  tft.drawBitmap(0, tft.maxY()/2 - 51/2, myBitmap, 224, 51, COLOR_WHITE, COLOR_RED);
  RGB_color(0,255,0);
  delay(150);
  tone(piezo_pin, 10);
  tft.drawBitmap(0, tft.maxY()/2 - 51/2, myBitmap, 224, 51, COLOR_WHITE, COLOR_BLUE);
  RGB_color(0,0,255);
  delay(150);
  tone(piezo_pin, 80);
  tft.drawBitmap(0, tft.maxY()/2 - 51/2, myBitmap, 224, 51, COLOR_WHITE, COLOR_BLACK);
  RGB_color(0,0,0);
  delay(150);
  tone(piezo_pin, 250);
  delay(200);
  noTone(piezo_pin);
  
  delay(1500);

  if (on == false){
    on = true;
    delay(100);
    tft.setFont(Terminal12x16);
    tft.fillRectangle(0, 0, tft.maxX(), tft.maxY(), COLOR_WHITE); //220 x 176

    //Draw rect1
    tft.drawText(tft.maxX()/2 - 60, 10, "Temperature", COLOR_RED);
    tft.drawRectangle(tft.maxX()/2 - 100, 30, tft.maxX()/2 + 100, 45, COLOR_BLACK);
    //Draw rect1 filling
    tft.fillRectangle(tft.maxX()/2 - 99, 31, tft.maxX()/2 - 40, 44, COLOR_BLUE);
    tft.fillRectangle(tft.maxX()/2 - 40, 31, tft.maxX()/2 + 10, 44, COLOR_GREEN);
    tft.fillRectangle(tft.maxX()/2 + 10, 31, tft.maxX()/2 + 40, 44, COLOR_YELLOW);
    tft.fillRectangle(tft.maxX()/2 + 40, 31, tft.maxX()/2 + 70, 44, COLOR_ORANGE);
    tft.fillRectangle(tft.maxX()/2 + 70, 31, tft.maxX()/2 + 99, 44, COLOR_RED);


    //Draw rect2
    tft.drawText(tft.maxX()/2 - 40, 90, "Pressure", COLOR_BLUE);
    tft.drawRectangle(tft.maxX()/2 - 100, 110, tft.maxX()/2 + 100, 125, COLOR_BLACK);
    //Draw rect2 filling
    tft.fillRectangle(tft.maxX()/2 - 99, 111, tft.maxX()/2 - 40, 124, COLOR_BLUE);
    tft.fillRectangle(tft.maxX()/2 - 40, 111, tft.maxX()/2 + 10, 124, COLOR_GREEN);
    tft.fillRectangle(tft.maxX()/2 + 10, 111, tft.maxX()/2 + 40, 124, COLOR_YELLOW);
    tft.fillRectangle(tft.maxX()/2 + 40, 111, tft.maxX()/2 + 70, 124, COLOR_ORANGE);
    tft.fillRectangle(tft.maxX()/2 + 70, 111, tft.maxX()/2 + 99, 124, COLOR_RED);
    tft.drawText(tft.maxX()/2 - 20 ,ty + 15, String(0) + "C", COLOR_BLACK);
    tft.drawText(tft.maxX()/2 - 20 ,ty2 + 15, String(0) + "MPa", COLOR_BLACK);

    while(true){
//      if (on == false){
//        on = false;
//        delay(100);
//      }
      x = sensor.readRangeContinuousMillimeters();
      Serial.print(x);
      if (sensor.timeoutOccurred()) { Serial.print(" TIMEOUT"); }
      Serial.println();
      if (x <= 55){
        pump++;
        while (x <= 73){
          x = sensor.readRangeContinuousMillimeters();
          Serial.print(x);
          Serial.println();
        }
      }
      if (pump < 4){
        RGB_color(0,0,255);
      }
      else if (pump >= 4 && pump < 7){
        RGB_color(0,255,0);
      }
      else if (pump >= 7 && pump < 8){
        RGB_color(255,255,0);
      }
      else if (pump >= 8 && pump < 10){
        RGB_color(255,50,0);
      }
      else if (pump >= 10){
        RGB_color(255,0,0);
      }
      else{
        RGB_color(0,0,0);
      }
      
    if (pump <= 11){
      hz = map(pump, 8, 11, 0, 500);
    }
    if (pump < 8 || pump > 11){
      noTone(piezo_pin);
    }
    else{
      tone(piezo_pin, hz);
    }
    
    temp = map(pump,0,11,100,2000);
    pres = map(pump,0,11,30,450);
    
    if (pump < 12){
        tx = map(pump,0,11,13,209);
        tx2 = map(pump,0,11,13,170);
        tft.drawText(tft.maxX()/2 - 30 ,ty + 15, String(temp) + " C", COLOR_BLACK);
        tft.drawText(tft.maxX()/2 - 30 ,ty2 + 15, String(pres) + " MPa", COLOR_BLACK);
    }
    if (prev_pump < pump){
      tft.fillRectangle(0,ty,tft.maxX(),ty + 10,COLOR_WHITE);
      tft.fillRectangle(0,ty2,tft.maxX(),ty2 + 10,COLOR_WHITE);
    }
    tft.fillTriangle(tx,ty,tx - 7,ty + 7,tx + 10,ty + 7,COLOR_BLACK);
    tft.fillTriangle(tx2,ty2,tx2 - 7,ty2 + 7,tx2 + 10,ty2 + 7,COLOR_BLACK);
    prev_pump = pump;
    }
  } //Turn on display
} //End of main

void RGB_color(int red_light_value, int green_light_value, int blue_light_value)
 {
  color.red = red_light_value;
  color.green = green_light_value;
  color.blue = blue_light_value;

  for(uint16_t i = 0; i < LED_COUNT; i++)
  {
    colors[i] = color;
  }
  ledStrip.write(colors, LED_COUNT);
}
